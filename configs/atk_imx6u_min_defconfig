## configs/atk_imx6u_min_defconfig
```kconfig
BR2_arm=y
BR2_cortex_a7=y
BR2_ARM_FPU_NEON_VFPV4=y
BR2_TARGET_GENERIC_HOSTNAME="ATK"
BR2_ROOTFS_OVERLAY="board/atk-imx6u/rootfs-overlay"
BR2_PACKAGE_ALSA_UTILS=y
BR2_PACKAGE_ALSA_UTILS_AMIXER=y
BR2_PACKAGE_ALSA_UTILS_APLAY=y
BR2_PACKAGE_DROPBEAR=y
```
